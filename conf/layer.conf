## conf/layer.conf
```bitbake
# We have a conf and classes directory, add to BBPATH
BBPATH .= ":${LAYERDIR}"

# We have recipes-* directories, add to BBFILES
BBFILES += "${LAYERDIR}/recipes-*/*/*.bb \
            ${LAYERDIR}/recipes-*/*/*.bbappend"

BBFILE_COLLECTIONS += "./meta-connected-house"
BBFILE_PATTERN_./meta-connected-house = "^${LAYERDIR}/"
BBFILE_PRIORITY_./meta-connected-house = "6"
```
